## arch/arm64/configs/selinux_defconfig
```kconfig
CONFIG_EXT2_FS_XATTR=n
CONFIG_EXT2_FS_SECURITY=n
CONFIG_EXT4_FS_XATTR=n
CONFIG_EXT4_FS_SECURITY=n
CONFIG_AUDIT=y
CONFIG_AUDITSYSCALL=n
CONFIG_SECURITY=n
CONFIG_LSM_MMAP_MIN_ADDR=4096
CONFIG_SECURITY_NETWORK=n
CONFIG_SECURITY_SELINUX=n
CONFIG_SECURITY_SELINUX_DEVELOP=n
CONFIG_SECURITY_SELINUX_AVC_STATS=n
CONFIG_SECURITY_SELINUX_CHECKREQPROT_VALUE=n
CONFIG_NETWORK_SECMARK=n
CONFIG_NF_CONNTRACK_SECMARK=n
CONFIG_NETFILTER_XT_TARGET_CONNSECMARK=n
CONFIG_NETFILTER_ADVANCED=n
CONFIG_IP_NF_SECURITY=n
CONFIG_DEFAULT_SECURITY=n
CONFIG_SDCARD_FS_XATTR=n
CONFIG_ECRYPT_FS_VIRTUAL_FAT_XATTR=n
CONFIG_FAT_VIRTUAL_XATTR=n
CONFIG_EXFAT_VIRTUAL_XATTR=n
```
